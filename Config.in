## Config.in
```kconfig
source "$BR2_EXTERNAL_INSTRUMENT_CLUSTER_OS_PATH/package/brcmfmac-firmware/Config.in"
source "$BR2_EXTERNAL_INSTRUMENT_CLUSTER_OS_PATH/package/python-instrument-cluster/Config.in"
source "$BR2_EXTERNAL_INSTRUMENT_CLUSTER_OS_PATH/package/python-pygame-261/Config.in"
source "$BR2_EXTERNAL_INSTRUMENT_CLUSTER_OS_PATH/package/python-blinkt/Config.in"
source "$BR2_EXTERNAL_INSTRUMENT_CLUSTER_OS_PATH/package/python-lgpio/Config.in"
source "$BR2_EXTERNAL_INSTRUMENT_CLUSTER_OS_PATH/package/python-rpi-lgpio/Config.in"
source "$BR2_EXTERNAL_INSTRUMENT_CLUSTER_OS_PATH/package/lg/Config.in"
```

## package/lg/Config.in
```kconfig
config BR2_PACKAGE_LG
	bool "lg (liblgpio/rgpio)"
	help
	  C GPIO library from abyz.me.uk (lg archive).
	  Provides liblgpio (local) and librgpio/rgpiod (remote).
	  Required by python-lgpio and rpi-lgpio shims.
```

## package/python-blinkt/Config.in
```kconfig
config BR2_PACKAGE_PYTHON_BLINKT
    bool "python-blinkt"
    depends on BR2_PACKAGE_PYTHON3
    help
      Eight super-bright RGB LED indicators, ideal for adding
      visual notifications to your Raspberry Pi on their own
      or on a pHAT stacking header.
      https://github.com/pimoroni/blinkt
```

## package/python-lgpio/Config.in
```kconfig
config BR2_PACKAGE_PYTHON_LGPIO
	bool "python-lgpio"
    depends on BR2_PACKAGE_LG
	help
	  Python bindings for the lg (lgpio) GPIO library used by modern
	  Raspberry Pi kernels (gpiochip). Required by python-rpi-lgpio.
	  https://abyz.me.uk/lg/py_lgpio.html
```

## package/python-rpi-lgpio/Config.in
```kconfig
config BR2_PACKAGE_PYTHON_RPI_LGPIO
	bool "python-rpi-lgpio"
	# Pure Python, but only useful if lgpio is present
	select BR2_PACKAGE_PYTHON_LGPIO
	help
	  A compatibility shim that provides the RPi.GPIO API on top of lgpio.
	  Useful on Raspberry Pi 5 (gpiochip) systems.
	  https://rpi-lgpio.readthedocs.io/
```
